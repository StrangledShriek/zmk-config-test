## boards/shields/zmk-config-test/Kconfig.defconfig
```kconfig
if SHIELD_ZMK_CONFIG_TEST_LEFT
config ZMK_KEYBOARD_NAME
    default "zmk-config-test"
config ZMK_SPLIT_ROLE_CENTRAL
    default y
endif

if SHIELD_ZMK_CONFIG_TEST_RIGHT
config ZMK_KEYBOARD_NAME
    default "zmk-config-test-right"
endif

if SHIELD_ZMK_CONFIG_TEST_LEFT || SHIELD_ZMK_CONFIG_TEST_RIGHT
config ZMK_SPLIT
    default y
config ZMK_BLE
    default y
config ZMK_SPLIT_BLE
    default y
endif
```

## boards/shields/zmk-config-test/Kconfig.shield
```kconfig
config SHIELD_ZMK_CONFIG_TEST_LEFT
    def_bool $(shields_list_contains,zmk-config-test_left)

config SHIELD_ZMK_CONFIG_TEST_RIGHT
    def_bool $(shields_list_contains,zmk-config-test_right)
```
